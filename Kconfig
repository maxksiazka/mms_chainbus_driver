## drivers/mms_chainbus/Kconfig
```kconfig
# SPDX-License-Identifier: Apache-2.0

menuconfig MMS_CHAINBUS
	bool "MMS Chainbus HAT Manager"
	default y
	depends on DT_HAS_KONAR_MMS_CHAINBUS_ENABLED
	help
	  Enable support for MMS Chainbus multi-slot HAT manager.

if MMS_CHAINBUS

config CHAINBUS_INIT_PRIORITY
	int "Chainbus Init Priority"
	default 55
	help
	  Initialization priority in POST_KERNEL. Must run before slot bridges.

module = MMS_CHAINBUS
module-str = mms_chainbus
source "subsys/logging/Kconfig.template.log_config"

endif # CHAINBUS
```

## dts/bindings/mms/konar,mms-chainbus.yaml
```yaml
# SPDX-License-Identifier: Apache-2.0

description: |
  MMS Chainbus HAT Manager.
  Manages physical HAT slots using an array of Chip Select GPIO lines.

compatible: "konar,mms-chainbus"

include: base.yaml

properties:
  cs-gpios:
    type: phandle-array
    required: true
    description: |
      Array of GPIO specifiers corresponding to physical HAT address lines (slots 0..7).

child-binding:
  description: HAT child node defined under chainbus

  properties:
    position:
      type: int
      description: |
        Optional explicit physical slot index (0..7).
        If omitted, slot index is resolved at boot via runtime auto-discovery.
```
